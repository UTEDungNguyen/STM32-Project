# file: TestSTM32_F4_6_3_2023.ioc
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Mcu.Family=STM32F4
Mcu.Name=STM32F401V(D-E)Tx
Mcu.Package=LQFP100
NVIC.PriorityGroup=NVIC_PRIORITYGROUP_4
ProjectManager.HeapSize=0x200
ProjectManager.StackSize=0x400
ProjectManager.TargetToolchain=MDK-ARM V5.27
RCC.AHBFreq_Value=16000000
RCC.APB1Freq_Value=16000000
RCC.APB2Freq_Value=16000000
RCC.CortexFreq_Value=16000000
RCC.HSE_VALUE=25000000
RCC.HSI_VALUE=16000000
RCC.LSE_VALUE=32768
RCC.SYSCLKFreq_VALUE=16000000
RCC.VCOOutputFreq_Value=192000000
board=custom

// file: Core/Src/main.c
/* USER CODE BEGIN Header */
/**
  ******************************************************************************
  * @file           : main.c
  * @brief          : Main program body
  ******************************************************************************
  * @attention
  *
  * Copyright (c) 2023 STMicroelectronics.
  * All rights reserved.
  *
  * This software is licensed under terms that can be found in the LICENSE file
  * in the root directory of this software component.
  * If no LICENSE file comes with this software, it is provided AS-IS.
  *
  ******************************************************************************
  */
/* USER CODE END Header */
#include "main.h"
#include "stdlib.h"
/* USER CODE BEGIN Includes */
int dem =0 ;
uint8_t data ;
uint8_t start_bit ;
int start_bit_int ;
int array[13];
int total=0;
/* USER CODE END Includes */

void UART2_SendChar (uint8_t c);
void UART2_SendString (char *string);
uint8_t UART2_GetChar ();

void SystemClock_Config(void);

int main(void)
{

  /* MCU Configuration--------------------------------------------------------*/

  /* Reset of all peripherals, Initializes the Flash interface and the Systick. */
  HAL_Init();

  /* Configure the system clock */
  SystemClock_Config();

  /* Initialize all configured peripherals */
  /* USER CODE BEGIN 2 */

	//Truy xuat chan D
		RCC->AHB1ENR |= (1<<3);  //Toan tu gan va or la truy suat vao 1 bit bat ky tren thanh ghi. Dang ky Cap xung cho output
		GPIOD->MODER = 0x55555555;  //Khai bao Output cho thanh ghi. 2 bit dieu khien 1 chan pin
		GPIOD->OTYPER = 0x0000;     //Khai bao mode output
		GPIOD->OSPEEDR = 0x55555555;

	//UART in STM32
	// 1. Enable the USART CLOCK and GPIO CLOCK
	RCC->APB1ENR |= (1<<17); // Enable UART2 CLOCK
	RCC->AHB1ENR |= (1<<0); // Enable GPIOA CLOCK
	// 2. Configure the USART PINs for Alternate Function
	GPIOA->MODER |= (2<<4); // Bits (5:4)= 1:0 --> Alternate Function for Pin PA2
	GPIOA->MODER |= (2<<6); // Bits (7:6)= 1:0 --> Alternate Function for Pin PA3

	GPIOA->OSPEEDR |= (3<<4)|(3<<6); // Bits (5:4) = 1:1 and Bits (7:6) =1:1 => High speed for PIN PA2 and PIN PA3

	GPIOA->AFR[0] |= (7<<8); // Bytes (11:10:9:8) = 0:1:1:1 --> AF7 Alternate function for UART2 at Pin PA2
	GPIOA->AFR[0] |= (7<<12); // Bytes (15:14:13:12) = 0:1:1:1 --> AF7 Alternate function for UART2 at Pin PA3
	// 3. Enable the USART by writing the UE bit in USART_CR1 register to 1
	USART2->CR1 = 0x00 ; // clear all
	USART2->CR1 |= (1<<13) ; // UE =1 ... Enable USART
  // 4. Program the M bit in USART_CR1 to define the word length
	USART2->CR1 &= ~(1<<12); // M=0;8 bit word length
	//5. Select the desired baudrate using USART_BRR register
	USART2->BRR = (3<<0)|(104<<4); // Baud rate 9600 , PCLK1 at 16MHz
	// 6. Enable the Transmitter/Receiver by Setting the TE and RE bits in USART_CR1 Register
	USART2->CR1 |= (1<<2); // RE=1 Enable Receiver
	USART2->CR1 |= (1<<3); // TE=1 Enable Transmitter

  /* USER CODE END 2 */

  /* Infinite loop */
  while (1)
  {
    /* USER CODE BEGIN 3 */
		start_bit = UART2_GetChar();
		start_bit_int = (int)(start_bit);

		if(start_bit_int == 126){
			while(dem != 8){
				data = UART2_GetChar();
				array[dem++] = data ;
				UART2_SendChar(data);
			}
			for(int x=8; x<=11;x++){
				array[x] = UART2_GetChar();
				total += (int)array[x];
			}
			if ((int)total == 295){
				for(int i=0; i<8; i++){
					int data_receive = (int)array[i]-48;
					if(data_receive ==1){
						GPIOD->BSRR = (1<<1)|(1<<16)|(1<<18);
						//HAL_Delay(5);
						GPIOD->BSRR = (1<<1)|(1<<0)|(1<<18);
						//HAL_Delay(5);
						GPIOD->BSRR = (1<<1)|(1<<16)|(1<<2);
						//HAL_Delay(5);
					}
					if(data_receive == 0){
						GPIOD->BSRR = (1<<17)|(1<<16)|(1<<18);
						//HAL_Delay(5);
						GPIOD->BSRR = (1<<17)|(1<<0)|(1<<18);
						//HAL_Delay(5);
						GPIOD->BSRR = (1<<17)|(1<<16)|(1<<2);
						//HAL_Delay(5);
					}
				}
//				UART2_SendChar(0x0A);
//				UART2_SendChar(0x0D);
				dem= 0 ;
				total =0;
			}
		}

  }
  /* USER CODE END 3 */
}

void SystemClock_Config(void)
{
  RCC_OscInitTypeDef RCC_OscInitStruct = {0};
  RCC_ClkInitTypeDef RCC_ClkInitStruct = {0};

  /** Configure the main internal regulator output voltage
  */
  __HAL_RCC_PWR_CLK_ENABLE();
  __HAL_PWR_VOLTAGESCALING_CONFIG(PWR_REGULATOR_VOLTAGE_SCALE2);

  /** Initializes the RCC Oscillators according to the specified parameters
  * in the RCC_OscInitTypeDef structure.
  */
  RCC_OscInitStruct.OscillatorType = RCC_OSCILLATORTYPE_HSI;
  RCC_OscInitStruct.HSIState = RCC_HSI_ON;
  RCC_OscInitStruct.HSICalibrationValue = RCC_HSICALIBRATION_DEFAULT;
  RCC_OscInitStruct.PLL.PLLState = RCC_PLL_NONE;
  if (HAL_RCC_OscConfig(&RCC_OscInitStruct) != HAL_OK)
  {
    Error_Handler();
  }

  /** Initializes the CPU, AHB and APB buses clocks
  */
  RCC_ClkInitStruct.ClockType = RCC_CLOCKTYPE_HCLK|RCC_CLOCKTYPE_SYSCLK
                              |RCC_CLOCKTYPE_PCLK1|RCC_CLOCKTYPE_PCLK2;
  RCC_ClkInitStruct.SYSCLKSource = RCC_SYSCLKSOURCE_HSI;
  RCC_ClkInitStruct.AHBCLKDivider = RCC_SYSCLK_DIV1;
  RCC_ClkInitStruct.APB1CLKDivider = RCC_HCLK_DIV1;
  RCC_ClkInitStruct.APB2CLKDivider = RCC_HCLK_DIV1;

  if (HAL_RCC_ClockConfig(&RCC_ClkInitStruct, FLASH_LATENCY_0) != HAL_OK)
  {
    Error_Handler();
  }
}

/* USER CODE BEGIN 4 */
//Ham UART truyen di
void UART2_SendChar (uint8_t c)
{
	USART2->DR = c; //Gui vao data vao thanh DR
	while(!(USART2->SR & (1<<6))); //wait TC duoc set . tho khi do da duoc truyen xong
}

void UART2_SendString (char *string)
{
	while(*string) UART2_SendChar(*string++);
}

//Ham UART nhan ve
uint8_t UART2_GetChar ()
{
	char value;
	while(!(USART2->SR & (1<<5))); //cho khi RXNE duoc set
	value = USART2->DR;    //dOC DATA
	return value;
}

/* USER CODE END 4 */

void Error_Handler(void)
{
  __disable_irq();
  while (1)
  {
  }
}
